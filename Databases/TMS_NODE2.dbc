VERSION ""

NS_ :

BS_:

BU_: TMS

BO_ 1154 TMS_PDO_4: 8 TMS
 SG_ V4 : 32|32@1+ (1,0) [0|4294967295] "" Vector__XXX
 SG_ V3 : 0|32@1+ (1,0) [0|4294967295] "" Vector__XXX

BO_ 898 TMS_PDO_3: 8 TMS
 SG_ V2 : 32|32@1+ (1,0) [0|4294967295] "" Vector__XXX
 SG_ V1 : 0|32@1+ (1,0) [0|4294967295] "" Vector__XXX

BO_ 642 TMS_PDO_2: 8 TMS
 SG_ Temp_4 : 32|32@1+ (0.001,0) [0|4294967.295] "" Vector__XXX
 SG_ Temp_3 : 0|32@1+ (0.001,0) [0|4294967.295] "" Vector__XXX

BO_ 386 TMS_PDO_1: 8 TMS
 SG_ Temp_2 : 32|32@1+ (0.001,0) [0|4294967.295] "" Vector__XXX
 SG_ Temp_1 : 0|32@1+ (0.001,0) [0|4294967.295] "" Vector__XXX

BA_DEF_  "BusType" STRING ;
BA_DEF_DEF_  "BusType" "CAN";
