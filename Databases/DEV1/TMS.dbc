VERSION ""

NS_ :

BS_:

BU_: TMS

BO_ 648 TMS_PDO_2: 8 Vector__XXX
 SG_ Temp_4 : 32|32@1+ (0.001,0) [0|4294967.295] "" Vector__XXX
 SG_ Temp_3 : 0|32@1+ (0.001,0) [0|4294967.295] "" Vector__XXX

BO_ 392 TMS_PDO_1: 8 TMS
 SG_ Temp_2 : 32|32@1+ (0.001,0) [0|4294967.295] "" Vector__XXX
 SG_ Temp_1 : 0|32@1+ (0.001,0) [0|4294967.295] "" Vector__XXX

BA_DEF_  "BusType" STRING ;
BA_DEF_DEF_  "BusType" "CAN";
