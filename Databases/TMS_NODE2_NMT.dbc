VERSION ""

NS_ :

BS_:

BU_: NMT_Master TMS
VAL_TABLE_ NMT_States 32768 "Preoperational" 256 "Operational" ;

BO_ 0 NMT_CMD: 2 Vector__XXX
 SG_ State : 0|16@1+ (1,0) [0|255] ""  TMS

BO_ 1154 TMS_PDO_4: 8 TMS
 SG_ V4 : 32|32@1+ (1,0) [0|4294967295] ""  NMT_Master
 SG_ V3 : 0|32@1+ (1,0) [0|4294967295] ""  NMT_Master

BO_ 898 TMS_PDO_3: 8 TMS
 SG_ V2 : 32|32@1+ (1,0) [0|4294967295] ""  NMT_Master
 SG_ V1 : 0|32@1+ (1,0) [0|4294967295] ""  NMT_Master

BO_ 642 TMS_PDO_2: 8 TMS
 SG_ Temp_4 : 32|32@1+ (0.001,0) [0|4294967.295] ""  NMT_Master
 SG_ Temp_3 : 0|32@1+ (0.001,0) [0|4294967.295] ""  NMT_Master

BO_ 386 TMS_PDO_1: 8 TMS
 SG_ Temp_2 : 32|32@1+ (0.001,0) [0|4294967.295] ""  NMT_Master
 SG_ Temp_1 : 0|32@1+ (0.001,0) [0|4294967.295] ""  NMT_Master

BA_DEF_  "BusType" STRING ;
BA_DEF_DEF_  "BusType" "CAN";
VAL_ 0 State 32768 "Preoperational" 256 "Operational" ;
